## conf/layer.conf
```bitbake
# We have a conf and classes directory, add to BBPATH
BBPATH .= ":${LAYERDIR}"

# We have recipes-* directories, add to BBFILES
BBFILES += "${LAYERDIR}/recipes-*/*/*.bb \
            ${LAYERDIR}/recipes-*/*/*.bbappend"

BBFILE_COLLECTIONS += "meta-subbareddy"
BBFILE_PATTERN_meta-subbareddy = "^${LAYERDIR}/"
BBFILE_PRIORITY_meta-subbareddy = "6"

LAYERDEPENDS_meta-subbareddy = "core"
LAYERSERIES_COMPAT_meta-subbareddy = "kirkstone"
```

## conf/local.conf
```bitbake
# This file is your local configuration file and is where all local user settings
# are placed. The comments in this file give some guide to the options a new user
CONF_VERSION = "2"
BB_NUMBER_THREADS = "4"
PARALLEL_MAKE = "-j4"

MACHINE = "raspberrypi4-64"
DISTRO ?= "poky"
PACKAGE_CLASSES ?= "package_ipk"
USER_CLASSES ?= "buildstats"

# ── RPi4 specific ──────────────────────────────────────────────
ENABLE_UART = "1"
IMAGE_FSTYPES += "wic.bz2"

# ── Init manager ───────────────────────────────────────────────
VIRTUAL-RUNTIME_init_manager = "systemd"
VIRTUAL-RUNTIME_initscripts = "systemd-compat-units"
DISTRO_FEATURES:append = " systemd wifi"
DISTRO_FEATURES_BACKFILL_CONSIDERED = "sysvinit"

# ── Remove unused features ─────────────────────────────────────
DISTRO_FEATURES:remove = " \
    x11 \
    wayland \
    bluetooth \
    pulseaudio \
    alsa \
    nfc \
    ptest \
"

# ── Debug / root access ────────────────────────────────────────
EXTRA_IMAGE_FEATURES ?= "debug-tweaks"
EXTRA_IMAGE_FEATURES += "debug-tweaks empty-root-password allow-empty-password allow-root-login"

# ── License ────────────────────────────────────────────────────
LICENSE_FLAGS_ACCEPTED += "commercial"

# ── Build optimizations ────────────────────────────────────────
INHERIT += "rm_work"
#NO_RECOMMENDATIONS = "1"

# ── RPi4 WiFi firmware (BCM43455 onboard chip) ─────────────────
RPI_EXTRA_CONFIG = "dtoverlay=disable-bt"

# ── wpa_supplicant: use nl80211 driver ─────────────────────────
PACKAGECONFIG:append:pn-wpa-supplicant = " nl80211"

# ── Disk monitoring ────────────────────────────────────────────
BB_DISKMON_DIRS ??= "\
    STOPTASKS,${TMPDIR},1G,100K \
    STOPTASKS,${DL_DIR},1G,100K \
    STOPTASKS,${SSTATE_DIR},1G,100K \
    STOPTASKS,/tmp,100M,100K \
    HALT,${TMPDIR},100M,1K \
    HALT,${DL_DIR},100M,1K \
    HALT,${SSTATE_DIR},100M,1K \
    HALT,/tmp,10M,1K"

PATCHRESOLVE = "noop"
PACKAGECONFIG:append:pn-qemu-system-native = " sdl"
PACKAGECONFIG:remove:pn-gstreamer1.0-plugins-bad = "vulkan"
```
